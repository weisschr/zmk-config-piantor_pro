## config/Kconfig
```kconfig
# SPDX-License-Identifier: MIT
CONFIG_ZMK_POINTING=y

config BOARD_ENABLE_DCDC
	bool "Enable DCDC mode"
	select SOC_DCDC_NRF52X
	default y
	depends on (BOARD_PIANTOR_PRO_BT_LEFT || BOARD_PIANTOR_PRO_BT_RIGHT)
```
